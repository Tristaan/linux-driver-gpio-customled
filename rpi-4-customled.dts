/dts-v1/;
/plugin/;

/{
	compatible = "brcm,bcm2835";
	fragment@0 {
		target-path = "/";
		__overlay__ {
			customled_device: customled_device {
				compatible = "brcm,bcm2835";
				customled-gpios = <&gpio 21 1>;
			};
		};
	};
};

